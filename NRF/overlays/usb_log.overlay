// Copyright (c) 2025 ETH Zurich and University of Bologna
// SPDX-License-Identifier: Apache-2.0

/ {
chosen {
		zephyr,console = &cdc_acm_uart0;
		zephyr,shell-uart = &cdc_acm_uart0;
		zephyr,uart-mcumgr = &cdc_acm_uart0;
		zephyr,bt-mon-uart = &cdc_acm_uart0;
		zephyr,bt-c2h-uart = &cdc_acm_uart0;
		zephyr,bt-uart=&cdc_acm_uart0;
		};
};