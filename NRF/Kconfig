## NRF/Kconfig
```kconfig
# Copyright (c) 2025 ETH Zurich and University of Bologna
# SPDX-License-Identifier: Apache-2.0

menu "SENSEI Configuration"

config SENSEI
	bool "Enable SENSEI SDK"
	default n
	help
	  Enable SENSEI SDK features.

rsource "drivers/Kconfig"
rsource "system/Kconfig"

endmenu
```

## NRF/boards/arm/nrf5340_senseiv1/Kconfig.board
```kconfig
# Copyright (c) 2025 ETH Zurich and University of Bologna
# SPDX-License-Identifier: Apache-2.0

config BOARD_NRF5340_SENSEIv1_CPUAPP
	bool "NRF5340 SENSEIv1 Application MCU"
	depends on SOC_NRF5340_CPUAPP_QKAA


config BOARD_NRF5340_SENSEIv1_CPUNET
	bool "NRF5340 SENSEIv1 Network MCU"
	depends on SOC_NRF5340_CPUNET_QKAA
```

## NRF/boards/arm/nrf5340_senseiv1/Kconfig.defconfig
```kconfig
# Copyright (c) 2025 ETH Zurich and University of Bologna
# SPDX-License-Identifier: Apache-2.0

if BOARD_NRF5340_SENSEIv1_CPUAPP

config BOARD
	default "nrf5340_senseiv1_cpuapp"


endif

if BOARD_NRF5340_SENSEIv1_CPUNET

config BOARD
	default "nrf5340_senseiv1_cpunet"

config BT_CTLR
	default y if BT

endif
```

## NRF/boards/arm/nrf5340_senseiv1/nrf5340_senseiv1_cpuapp_bootloader_defconfig
```kconfig
# Copyright (c) 2025 ETH Zurich and University of Bologna
# SPDX-License-Identifier: Apache-2.0

CONFIG_SOC_SERIES_NRF53X=y
CONFIG_SOC_NRF5340_CPUAPP_QKAA=y
CONFIG_BOARD_NRF5340_SENSEIv1_CPUAPP=y

# Enable MPU
CONFIG_ARM_MPU=y

# Enable hardware stack protection
CONFIG_HW_STACK_PROTECTION=y

# Enable TrustZone-M
CONFIG_ARM_TRUSTZONE_M=y

# Enable Drivers
CONFIG_GPIO=y
CONFIG_I2C=y
CONFIG_ADC=y
CONFIG_MBOX=y
CONFIG_MBOX_NRFX_IPC=y

# Serial
CONFIG_SERIAL=y
CONFIG_UART_INTERRUPT_DRIVEN=y

# USB
CONFIG_USB_DEVICE_STACK=y
CONFIG_USB_DEVICE_PRODUCT="MCUBOOT"
CONFIG_USB_CDC_ACM=y
CONFIG_USB_COMPOSITE_DEVICE=y
CONFIG_USB_MASS_STORAGE=n
CONFIG_USB_DEVICE_MANUFACTURER="Nordic Semiconductor"
CONFIG_USB_DEVICE_VID=0x1915
CONFIG_USB_DEVICE_PID=0x520F

CONFIG_MULTITHREADING=y

# Enable Zephyr console on RTT
CONFIG_LOG=y
CONFIG_USE_SEGGER_RTT=y
CONFIG_RTT_CONSOLE=y
CONFIG_CONSOLE=y
CONFIG_CONSOLE_HANDLER=y
CONFIG_UART_CONSOLE=n

# MCUboot serial recovery
CONFIG_MCUBOOT_SERIAL=y
CONFIG_BOOT_SERIAL_CDC_ACM=y

# MCUBoot Configuration
CONFIG_BOOT_VALIDATE_SLOT0=n
CONFIG_BOOT_SIGNATURE_TYPE_NONE=y
CONFIG_BOOT_SERIAL_WAIT_FOR_DFU=y
CONFIG_BOOT_SERIAL_DETECT_DELAY=500
# CONFIG_USB_DFU_ENABLE_UPLOAD=y
# CONFIG_BOOT_USB_DFU_WAIT=y

CONFIG_UPDATEABLE_IMAGE_NUMBER=1
CONFIG_MCUBOOT_SERIAL_DIRECT_IMAGE_UPLOAD=y
```

## NRF/boards/arm/nrf5340_senseiv1/nrf5340_senseiv1_cpuapp_defconfig
```kconfig
# Copyright (c) 2025 ETH Zurich and University of Bologna
# SPDX-License-Identifier: Apache-2.0

CONFIG_SOC_SERIES_NRF53X=y
CONFIG_SOC_NRF5340_CPUAPP_QKAA=y
CONFIG_BOARD_NRF5340_SENSEIv1_CPUAPP=y

# Enable MPU
CONFIG_ARM_MPU=y

# Enable hardware stack protection
CONFIG_HW_STACK_PROTECTION=y

# Enable TrustZone-M
CONFIG_ARM_TRUSTZONE_M=y

# Enable Drivers
CONFIG_GPIO=y
CONFIG_MBOX=y
CONFIG_MBOX_NRFX_IPC=y
CONFIG_SERIAL=y

CONFIG_REBOOT=y

## USB Configuration ##
CONFIG_USB_DEVICE_STACK=y
CONFIG_USB_DEVICE_PRODUCT="SENSEI USB Console"
CONFIG_USB_CDC_ACM=y
CONFIG_USB_COMPOSITE_DEVICE=y
CONFIG_USB_MASS_STORAGE=n
CONFIG_USB_DEVICE_MANUFACTURER="Nordic Semiconductor"
CONFIG_USB_DEVICE_VID=0x1915
CONFIG_USB_DEVICE_PID=0x520F

CONFIG_MULTITHREADING=y

CONFIG_CONSOLE=y
CONFIG_STDOUT_CONSOLE=y
CONFIG_UART_CONSOLE=y

# # Enable Zephyr console on RTT
# CONFIG_USE_SEGGER_RTT=y
# CONFIG_RTT_CONSOLE=y
```

## NRF/boards/arm/nrf5340_senseiv1/nrf5340_senseiv1_cpunet_defconfig
```kconfig
# Copyright (c) 2025 ETH Zurich and University of Bologna
# SPDX-License-Identifier: Apache-2.0

CONFIG_SOC_SERIES_NRF53X=y
CONFIG_SOC_NRF5340_CPUNET_QKAA=y
CONFIG_BOARD_NRF5340_SENSEIv1_CPUNET=y

# Enable MPU
CONFIG_ARM_MPU=y

# Enable hardware stack protection
CONFIG_HW_STACK_PROTECTION=y

# Enable Drivers
CONFIG_GPIO=y
CONFIG_MBOX=y
CONFIG_MBOX_NRFX_IPC=y
CONFIG_SERIAL=y
```

## NRF/boards/shields/SENSEI_DebugBoard/Kconfig.shield
```kconfig
# Copyright (c) 2025 ETH Zurich and University of Bologna
# SPDX-License-Identifier: Apache-2.0

config SHIELD_SENSEI_DEBUGBOARD
	def_bool $(shields_list_contains,SENSEI_DebugBoard_v1)
```

## NRF/boards/shields/UT_SensorShield/Kconfig.shield
```kconfig
# Copyright (c) 2025 ETH Zurich and University of Bologna
# SPDX-License-Identifier: Apache-2.0

config SHIELD_UT_SENSORSHIELD
	def_bool $(shields_list_contains,UT_SensorShield_v1)
```

## NRF/boards/shields/UT_SensorShield/UT_SensorShield_v1.defconfig
```kconfig
# Copyright (c) 2025 ETH Zurich and University of Bologna
# SPDX-License-Identifier: Apache-2.0

CONFIG_GPIO_PCA64XXA=y
CONFIG_BME680=y
```

## NRF/drivers/Kconfig
```kconfig
# Copyright (c) 2025 ETH Zurich and University of Bologna
# SPDX-License-Identifier: Apache-2.0

menu "Drivers"
rsource "gpio/Kconfig"
rsource "led/Kconfig"
endmenu
```

## NRF/drivers/gpio/Kconfig
```kconfig
# Copyright (c) 2023 SILA Embedded Solutions GmbH
# SPDX-License-Identifier: Apache-2.0

if GPIO
rsource "Kconfig.pca64xxa"
endif
```

## NRF/drivers/gpio/Kconfig.pca64xxa
```kconfig
# Copyright (c) 2023 SILA Embedded Solutions GmbH
# SPDX-License-Identifier: Apache-2.0

menuconfig GPIO_PCA64XXA
	bool "PCA64XXA I2C GPIO chip"
	default y
	depends on DT_HAS_NXP_PCA6416A_ENABLED
	select I2C
	help
	  Enable driver for PCA64XXA I2C GPIO chip.

config GPIO_PCA64XXA_INIT_PRIORITY
	int "Init priority"
	default 70
	depends on GPIO_PCA64XXA
	help
	  Device driver initialization priority.
```

## NRF/drivers/led/Kconfig
```kconfig
# Copyright (c) 2018 Linaro Limited
# SPDX-License-Identifier: Apache-2.0

# Top-level configuration file for LED drivers.

if LED
rsource "Kconfig.is31fl3194"
endif # LED
```

## NRF/dts/bindings/gpio/nxp,pca6416a.yaml
```yaml
# Copyright (c) 2023 SILA Embedded Solutions GmbH
# SPDX-License-Identifier: Apache-2.0
---

description: PCA6416A 16-bit I2C-based I/O expander

compatible: "nxp,pca6416a"

include: nxp,pcal64xxa-base.yaml

properties:
  ngpios:
    required: true
    const: 16
```

## NRF/system/Kconfig
```kconfig
# Copyright (c) 2025 ETH Zurich and University of Bologna
# SPDX-License-Identifier: Apache-2.0

menu "System"

menuconfig SENSEI_COMM
	bool "Enable the SENSEI Communication Subsystem"
	default n
	depends on SENSEI
	help
	  Enable the SENSEI Communication Subsystem.

menuconfig SENSEI_PWR
	bool "Enable the SENSEI Power Subsystem"
	default n
	depends on SENSEI
	help
	  Enable the SENSEI Power Subsystem.

endmenu
```

## example/camera_test/src_GAP9/Kconfig
```kconfig
# Copyright (c) 2022 GreenWaves Technologies
# SPDX-License-Identifier: Apache-2.0

source "$(GAP_SDK_HOME)/utils/kconfig/Kconfig"

menu "Test ISP + CSI2 HM0360 Menu"

    config SAVING_PICTURE
        bool "Saving pictures"
        default y
        select DRIVER_HOSTFS
        help
            Save last taken picture in a file. Available in ppm and jpg formats.

    config APP_LOG
        bool "Enable logs"
        default n
        help
            Print some additionals informations to help debugging

    if APP_LOG
        source "$(KCONFIG_UTILS_DIR)/logs.kconfig"
    endif

    # Shortcut to OV5647 driver options
    source "$(KCONFIG_DRIVERS_DIR)/camera/drivers_hm0360_options.kconfig"

endmenu
```

## example/exg_stream/src_NRF/Kconfig
```kconfig
#
# Copyright (c) 2018 Nordic Semiconductor
#
# SPDX-License-Identifier: LicenseRef-Nordic-5-Clause
#

source "Kconfig.zephyr"

menu "Nordic UART BLE GATT service sample"

config BT_NUS_THREAD_STACK_SIZE
	int "Thread stack size"
	default 1024
	help
	  Stack size used in each of the two threads

config BT_NUS_UART_BUFFER_SIZE
	int "UART payload buffer element size"
	default 500
	help
	  Size of the payload buffer in each RX and TX FIFO element

config BT_NUS_SECURITY_ENABLED
	bool "Enable security"
	default y
	select BT_SMP
	help
	  "Enable BLE security for the UART service"

config BT_NUS_UART_RX_WAIT_TIME
	int "Timeout for UART RX complete event"
	default 50000
	help
	  Wait for RX complete event time in microseconds

config BT_NUS_UART_ASYNC_ADAPTER
	bool "Enable UART async adapter"
	select SERIAL_SUPPORT_ASYNC
	help
	  Enables asynchronous adapter for UART drives that supports only
	  IRQ interface.

config HAS_SEGGER_RTT
	bool "Enable Segger RTT"
	default y

endmenu

menu "State Machine Configuration"

config STATE_MACHINE_USE_CPU_IDLE
	bool "Use k_cpu_idle() instead of k_sleep() in state machine loop"
	default n
	help
	  If enabled, the state machine thread will use k_cpu_idle() instead of
	  k_sleep(K_USEC(1)) between state run() iterations. k_cpu_idle() keeps
	  the CPU more responsive but may consume more power. k_sleep() yields
	  CPU time to other threads more effectively and reduces power consumption.

endmenu

menu "ExG Streaming Configuration"

config ADS_USE_BIPOLAR_MODE
	bool "Use bipolar mode for ADS (ExG shield)"
	default n
	help
	  If enabled, the ADS (Analog-to-Digital Sensor) will be powered on in
	  bipolar mode when entering the S_NORDIC_STREAM state. If disabled,
	  unipolar mode is used. The choice depends on the ExG shield hardware
	  configuration and the type of biopotential signals being measured.
	  
	  - Bipolar mode (EMG): Differential measurement between two electrodes
	  - Unipolar mode (EEG): Single-ended measurement referenced to ground

endmenu
```

## west.yml
```yaml
# Copyright (c) 2025 ETH Zurich and University of Bologna
# SPDX-License-Identifier: Apache-2.0
---

manifest:
  self:
    path: sensei-sdk

  remotes:
    - name: ncs
      url-base: https://github.com/nrfconnect

  projects:
    - name: sdk-nrf
      remote: ncs
      path: nrf
      revision: v2.6.1
      import: true
      west-commands: scripts/west-commands.yml
    - name: ubxlib
      url: https://github.com/u-blox/ubxlib.git
      path: modules/ubxlib
```
